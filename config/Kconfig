## config/Kconfig
```kconfig
# Charybdis ZMK config module Kconfig

menuconfig ZMK_BEHAVIOR_NORDIC_DFU
	bool "Enable Nordic DFU bootloader entry behavior"
	default y
	depends on DT_HAS_ZMK_BEHAVIOR_NORDIC_DFU_ENABLED
	help
	  Enables the &nordic_dfu behavior. Sets GPREGRET to 0xB1
	  (BOOTLOADER_DFU_START) and reboots the device so the
	  Nordic Open DFU Bootloader (and the Adafruit nRF52 UF2
	  bootloader) stays in DFU mode after the reset.
```

## config/dts/bindings/zmk,behavior-nordic-dfu.yaml
```yaml
description: |
  Nordic DFU bootloader entry behavior.

  Writes 0xB1 (BOOTLOADER_DFU_START) to the nRF52 GPREGRET register
  and reboots, so the bootloader stays in DFU mode. Works with the
  Nordic Open DFU Bootloader (e.g. Holyiot USB dongles, PCA10059)
  and the Adafruit nRF52 UF2 bootloader (e.g. nice!nano).

compatible: "zmk,behavior-nordic-dfu"

include: zero_param.yaml
```
