## config/west.yml
```yaml
manifest:
  remotes:
    - name: zmkfirmware
      url-base: https://github.com/zmkfirmware

    - name: badjeff
      url-base: https://github.com/badjeff

  projects:
    - name: zmk
      remote: zmkfirmware
      revision: 268b1b1e
      import: app/west.yml

    - name: zmk-pmw3610-driver
      remote: badjeff
      revision: 44b4a76

  self:
    path: config
```
